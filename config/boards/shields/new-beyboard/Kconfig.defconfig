## config/boards/shields/new-beyboard/Kconfig.defconfig
```kconfig
if SHIELD_NEW_BEYBOARD_LEFT

config ZMK_KEYBOARD_NAME
    default "New Beyboard"

config ZMK_SPLIT_BLE_ROLE_CENTRAL
    default y

endif

if SHIELD_NEW_BEYBOARD_LEFT || SHIELD_NEW_BEYBOARD_RIGHT

config ZMK_SPLIT
    default y

endif
```

## config/boards/shields/new-beyboard/Kconfig.shield
```kconfig
config SHIELD_NEW_BEYBOARD_LEFT
    def_bool $(shields_list_contains,new_beyboard_left)

config SHIELD_NEW_BEYBOARD_RIGHT
    def_bool $(shields_list_contains,new_beyboard_right)
```
